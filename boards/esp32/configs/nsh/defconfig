## libraries/sqlite/Kconfig
```kconfig
#
# For a description of the syntax of this configuration file,
# see the file kconfig-language.txt in the NuttX tools repository.
#

config LIB_SQLITE
	tristate "SQLITE library"
	default y

if LIB_SQLITE

config TOOLS_SQLITE
	bool "SQLITE cmd line tool"
	default n

config TOOLS_SQLITE_STACKSIZE
	int "SQLITE3 stack size"
	default 16384

endif
```

## projects/demo/Kconfig
```kconfig
#
# For a description of the syntax of this configuration file,
# see the file kconfig-language.txt in the NuttX tools repository.
#

config PROJECT_DEMO
	tristate "Demo project"
	default y

if PROJECT_DEMO

config PROJECT_DEMO_STACKSIZE
	int "Demo stack size"
	default DEFAULT_TASK_STACKSIZE

endif
```
